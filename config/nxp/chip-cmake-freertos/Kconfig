## config/nxp/chip-cmake-freertos/Kconfig
```kconfig
#
#   Copyright (c) 2024 Project CHIP Authors
#
#   Licensed under the Apache License, Version 2.0 (the "License");
#   you may not use this file except in compliance with the License.
#   You may obtain a copy of the License at
#
#       http://www.apache.org/licenses/LICENSE-2.0
#
#   Unless required by applicable law or agreed to in writing, software
#   distributed under the License is distributed on an "AS IS" BASIS,
#   WITHOUT WARRANTIES OR CONDITIONS OF ANY KIND, either express or implied.
#   See the License for the specific language governing permissions and
#   limitations under the License.
#

rsource "../cmake/Kconfig.matter.common"
rsource "../cmake/Kconfig.matter.nxp"
rsource "Kconfig.features"
rsource "../../../third_party/nxp/nxp_matter_support/cmake/Kconfig"

if CHIP

config APP_FREERTOS_OS
	bool "FreeRTOS Application OS"
	default y
	help
		When enabled this will differentiate between FreeRTOS and Zephyr in common NXP app code.

config CHIP_NXP_PLATFORM_NAME
	string "NXP platform"
	default "rt/rw61x" if CHIP_SDK_DEPENDENCIES_RW61X
	default "rt/rt1170" if CHIP_SDK_DEPENDENCIES_RT1170
	default "rt/rt1060" if CHIP_SDK_DEPENDENCIES_RT1060
	default "not specified"
	help
		Defines the platform name to be used (equivalent to "nxp_platform" gn arg).

choice CHIP_NVM_COMPONENT
	prompt "NVM Component selection"
	default CHIP_NVM_COMPONENT_NVS
	
	config CHIP_NVM_COMPONENT_NVS
		bool "NVS"
		help
			Use NVS component to store CHIP data.

	config CHIP_NVM_COMPONENT_LITTLEFS
		bool "LittleFS"
		help
			Use LittleFS component to store CHIP data. 
		
	config CHIP_NVM_COMPONENT_KEYSTORAGE
		bool "Key Storage"
		help
			Use the KeyStorage component to store CHIP data.

	config CHIP_NVM_COMPONENT_NVMFWK
		bool "NVM Framework"
		help
			Use the NVM Framework component to store CHIP data.
endchoice	

choice CHIP_CRYPTO
	prompt "CHIP Crypto selection"
	default CHIP_CRYPTO_MBEDTLS
	
	config CHIP_CRYPTO_MBEDTLS
		bool "CHIP MbeTLS crypto"
		help
			Use mbedtls for the crypto.
	
	config CHIP_CRYPTO_PLATFORM
		bool "CHIP platform crypto"
		help
			Use platform crypto.

	config CHIP_CRYPTO_PSA
		bool "CHIP PSA crypto"
		help
			Use PSA API for crypto.
endchoice

# Thread network features

if NET_L2_OPENTHREAD

endif # NET_L2_OPENTHREAD

config CHIP_IPV4
	bool "IPv4 support for Matter"
	help
	  If disabled, it allows to build NXP SDK application
	  with IPv4 support independently of the Matter stack still
	  running over IPv6.

endif # CHIP
```

## config/nxp/cmake/Kconfig.openthread.common
```kconfig
#
#   Copyright (c) 2024 Project CHIP Authors
#
#   Licensed under the Apache License, Version 2.0 (the "License");
#   you may not use this file except in compliance with the License.
#   You may obtain a copy of the License at
#
#       http://www.apache.org/licenses/LICENSE-2.0
#
#   Unless required by applicable law or agreed to in writing, software
#   distributed under the License is distributed on an "AS IS" BASIS,
#   WITHOUT WARRANTIES OR CONDITIONS OF ANY KIND, either express or implied.
#   See the License for the specific language governing permissions and
#   limitations under the License.
#

if NET_L2_OPENTHREAD

config OT_ROOT
	string "OT root path"
	default "third_party/openthread/ot-nxp/openthread"
	help
	  OT root path relative to Matter root

config OT_EXTERNAL_MBEDTLS
	string "Mbedtls gn target used by OT gn build system"
	default "nxp_mbedtls"
	help
	  Use "${nxp_sdk_build_root}:nxp_mbedtls" by default.
	  The full path is handled in common.cmake. If blank,
	  OT will use internal mbedtls.

config OT_EXTERNAL_PLATFORM
	string "OT external platform target used by OT gn build system"
	default "libopenthread-k32w1" if CHIP_NXP_PLATFORM_K32W1 || CHIP_NXP_PLATFORM_MCXW71
	default "libopenthread-mcxw72" if CHIP_NXP_PLATFORM_MCXW72
	help
	  OT external platform target used by OT gn build system

config OT_PROJECT_CORE_CONFIG_FILE
	string "OT configuration file used by OT gn build system"
	default "examples/platform/nxp/mcxw71_k32w1/app/project_include/openthread/OpenThreadConfig.h" if CHIP_NXP_PLATFORM_K32W1 || CHIP_NXP_PLATFORM_MCXW71
	default "third_party/nxp/nxp_matter_support/examples/platform/mcxw72/app/project_include/openthread/OpenThreadConfig.h" if CHIP_NXP_PLATFORM_MCXW72
	help
	  OT configuration file used by OT gn build system.

config OT_CORE_CONFIG_PLATFORM_CHECK_FILE
	string "OT core configuration check file used by OT gn build system"
	default "openthread-core-k32w1-config-check.h" if CHIP_NXP_PLATFORM_K32W1
	default "openthread-core-mcxw71-config-check.h" if CHIP_NXP_PLATFORM_MCXW71
	default "openthread-core-mcxw72-config-check.h" if CHIP_NXP_PLATFORM_MCXW72
	help
	  OT core configuration check file used by OT gn build system

config OT_CORE_CONFIG_DEPS
	string "OT core configuration gn deps file used by OT gn build system"
	default "third_party/openthread/platforms/nxp/mcxw71_k32w1:openthread_core_config_k32w1" if CHIP_NXP_PLATFORM_K32W1 || CHIP_NXP_PLATFORM_MCXW71
    default "third_party/openthread/platforms/nxp/mcxw72:openthread_core_config_mcxw72" if CHIP_NXP_PLATFORM_MCXW72
	help
	  OT core configuration gn deps file used by OT gn build system

config OT_NXP_PLATFORM_FOLDER
	string "ot-nxp platform specific folder"
	default "src/k32w1" if CHIP_NXP_PLATFORM_K32W1
	default "src/mcxw71" if CHIP_NXP_PLATFORM_MCXW71
	default "src/mcxw72" if CHIP_NXP_PLATFORM_MCXW72
	help
	  ot-nxp platform specific folder (relative to ot-nxp root)

endif # NET_L2_OPENTHREAD
```

## config/nxp/cmake/Kconfig.se05x
```kconfig
#
#   Copyright (c) 2024-2025 Project CHIP Authors
#
#   Licensed under the Apache License, Version 2.0 (the "License");
#   you may not use this file except in compliance with the License.
#   You may obtain a copy of the License at
#
#       http://www.apache.org/licenses/LICENSE-2.0
#
#   Unless required by applicable law or agreed to in writing, software
#   distributed under the License is distributed on an "AS IS" BASIS,
#   WITHOUT WARRANTIES OR CONDITIONS OF ANY KIND, either express or implied.
#   See the License for the specific language governing permissions and
#   limitations under the License.
#

if CHIP

config CHIP_SE05X
    bool "Enable SE05X secure element support"
    select SE05X_LIB
	select I2C
	select PINCTRL
    help
        Enable support for NXP SE05X secure element.
        The SE05X provides hardware-based cryptographic operations,
        secure key storage, and device attestation capabilities.
        When enabled, cryptographic operations (ECDSA, ECDH, etc.)
        will be offloaded to the SE05X hardware instead of using
        software implementations.

config CHIP_NXP_CRYPTO_IMPL
	string "NXP Crypto Implementation chosen"
	default "se05x" if CHIP_SE05X
	default "psa" if CHIP_CRYPTO_PSA
	default ""
	help
		Defines crypto implementation to be used

if CHIP_SE05X

    config CHIP_SE05X_SPAKE_VERIFIER
        bool "Enable SE05x Secure element for offloading spake verifier"
        help
            Enable SE05x Secure element for offloading spake verifier.

    config CHIP_SE05X_SPAKE_PROVER
        bool "Enable SE05x Secure element for offloading spake prover"
        help
            Enable SE05x Secure element for offloading spake prover.

    config CHIP_SE05X_RND_GEN
        bool "Enable SE05x Secure element for offloading random number generation"
        help
            Enable SE05x Secure element for offloading random number generation.

    config CHIP_SE05X_DEVICE_ATTESTATION
        bool "Enable SE05x Secure element for offloading Device attestation Sign"
        default y if CHIP_FACTORY_DATA
        help
                Enable SE05x Secure element for offloading Device attestation Sign.

    config CHIP_SE05X_SPAKE_VERIFIER_USE_TP_VALUES
        bool "Enable SE05x Secure element for offloading spake verifier and use the trust provisioned w0 and L values"
        depends on CHIP_SE05X_SPAKE_VERIFIER
        depends on CHIP_FACTORY_DATA
        default n
        help
            Enable SE05x Secure element for offloading spake verifier and use the trust provisioned w0 and L values. This
            should be enable only if factory data is configured.

    config CHIP_SE05X_SPAKE_VERIFIER_TP_SET_NO
        int "SE05x Trust Provisioned spake verifier set number"
        default 1
        range 1 3
        help
            SE05x Trust Provisioned spake verifier set number.

    config CHIP_SE05X_SPAKE_VERIFIER_TP_ITER_CNT
        int "SE05x Trust Provisioned spake verifier iteration count"
        default 1000
        help
            SE05x Trust Provisioned spake verifier iteration count.

endif # CHIP_SE05X

endif # CHIP
```
